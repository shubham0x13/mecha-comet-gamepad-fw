## CMakeLists.txt
```
# Copyright (c) 2026 Mecha Systems
# SPDX-License-Identifier: BSD-3-Clause

cmake_minimum_required(VERSION 3.28.0)

# The build variants in snippets/ are used with `west build -S <name>`.
list(APPEND SNIPPET_ROOT ${CMAKE_CURRENT_SOURCE_DIR})

find_package(Zephyr REQUIRED HINTS $ENV{ZEPHYR_BASE})
project(comet_gamepad)

# Headers are included with their folder, for example "modules/usb/gamepad_hid.h".
target_include_directories(app PRIVATE src)

target_sources(app PRIVATE src/main.c)

# events: how the parts tell each other what happened.
# modules: what the gamepad does, one file per part.
# util: code that knows nothing about the gamepad, used by the modules.
add_subdirectory(src/events)
add_subdirectory(src/modules)
add_subdirectory(src/util)
```

## Kconfig
```
# Copyright (c) 2026 Mecha Systems
# SPDX-License-Identifier: BSD-3-Clause

# Application Kconfig entry point. Browse options with `west build -t menuconfig`.
# Each part that has options keeps them in a Kconfig.<part> file next to its source.

menu "Zephyr"
source "Kconfig.zephyr"
endmenu

rsource "src/modules/Kconfig"
rsource "src/util/Kconfig"

module = COMET_GAMEPAD
module-str = Comet Gamepad
source "subsys/logging/Kconfig.template.log_config"
```

## prj.conf
```kconfig
# Copyright (c) 2026 Mecha Systems
# SPDX-License-Identifier: BSD-3-Clause

CONFIG_LOG=y

# Buttons and sticks arrive as input events.
CONFIG_INPUT=y

# The USB serial number comes from the unique ID of the chip.
CONFIG_HWINFO=y

# Restarting the chip, for the combinations that restart it.
CONFIG_REBOOT=y

# Events between the parts of the firmware, such as the USB state for the status LED.
CONFIG_ZBUS=y

# Settings kept in flash (see src/modules/storage.c). The factory reset erases the same partition.
CONFIG_FLASH=y
CONFIG_FLASH_MAP=y
CONFIG_NVS=y
CONFIG_SETTINGS=y
CONFIG_SETTINGS_NVS=y
# Every stored value has a CRC. Changing this later makes the values stored before unreadable.
CONFIG_NVS_DATA_CRC=y

CONFIG_USB_DEVICE_STACK_NEXT=y
CONFIG_USBD_LOG_LEVEL_WRN=y
CONFIG_USBD_HID_LOG_LEVEL_WRN=y
CONFIG_UDC_DRIVER_LOG_LEVEL_WRN=y
```

## debug.conf
```kconfig
# Copyright (c) 2026 Mecha Systems
# SPDX-License-Identifier: BSD-3-Clause

# More logging on the UART: every input event of the buttons and sticks, and what is read from and
# written to the stored settings. Keep it out of releases. Use it with:
#   west build -b mecha_comet_gamepad mecha-comet-gamepad-fw/app -- -DEXTRA_CONF_FILE=debug.conf
CONFIG_INPUT_EVENT_DUMP=y
CONFIG_INPUT_QUEUE_MAX_MSGS=64
CONFIG_LOG_BUFFER_SIZE=4096
CONFIG_SETTINGS_LOG_LEVEL_DBG=y
CONFIG_NVS_LOG_LEVEL_DBG=y
```

## stack-analysis.conf
```kconfig
# Copyright (c) 2026 Mecha Systems
# SPDX-License-Identifier: BSD-3-Clause

# Prints the stack use of every thread and of the interrupt stack on the UART every 5 seconds, to
# size the stacks. Keep it out of releases. The Cortex-M0+ has no MPU, so a stack that is too small
# corrupts memory without a fault: the sentinel catches that during the tests. Use it with:
#   west build -b mecha_comet_gamepad mecha-comet-gamepad-fw/app -- \
#     -DEXTRA_CONF_FILE=stack-analysis.conf
CONFIG_THREAD_ANALYZER=y
CONFIG_THREAD_ANALYZER_USE_PRINTK=y
CONFIG_THREAD_ANALYZER_AUTO=y
CONFIG_THREAD_ANALYZER_AUTO_INTERVAL=5
CONFIG_THREAD_NAME=y
CONFIG_STACK_SENTINEL=y
```

## app.overlay
```dts
/*
 * Copyright (c) 2026 Mecha Systems
 *
 * SPDX-License-Identifier: BSD-3-Clause
 */

/*
 * How often the analog sticks are measured and how often the host reads the gamepad, in
 * milliseconds. The buttons are not part of this: they use GPIO interrupts, or polling on the
 * ports that have none.
 */
#define COMET_GAMEPAD_SAMPLE_PERIOD_MS 4

&left_stick {
	poll-period-ms = <COMET_GAMEPAD_SAMPLE_PERIOD_MS>;
};

&pivot_pip {
	poll-period-ms = <COMET_GAMEPAD_SAMPLE_PERIOD_MS>;
};

/ {
	/* The HID gamepad. The report descriptor is in src/modules/usb/gamepad_hid.c. */
	hid_gamepad: hid-gamepad {
		compatible = "zephyr,hid-device";
		label = "Mecha Comet Gamepad Extension";
		protocol-code = "none";
		/* Must be at least GAMEPAD_HID_REPORT_SIZE. */
		in-report-size = <11>;

		/*
		 * How often the host polls the gamepad. This also sets the fastest report rate, because a
		 * report is sent when the host has read the previous one.
		 */
		in-polling-period-us = <(COMET_GAMEPAD_SAMPLE_PERIOD_MS * 1000)>;
	};
};
```

## src/main.c
```c
/*
 * Copyright (c) 2026 Mecha Systems
 *
 * SPDX-License-Identifier: BSD-3-Clause
 */

#include <errno.h>
#include <stdint.h>

#include <zephyr/app_version.h>
#include <zephyr/kernel.h>
#include <zephyr/logging/log.h>

#include "modules/gamepad_input.h"
#include "modules/gamepad_state.h"
#include "modules/gamepad_combos.h"
#include "modules/usb/gamepad_hid.h"
#include "modules/status_led.h"
#include "modules/storage.h"
#include "modules/usb/gamepad_usb.h"

/* Time to wait after a report could not be sent, so errors do not flood the log. */
#define ERROR_RETRY_DELAY_MS 10

LOG_MODULE_REGISTER(comet_gamepad, CONFIG_COMET_GAMEPAD_LOG_LEVEL);

/* Given when the gamepad state changed or when the host became ready for reports. */
static K_SEM_DEFINE(report_sem, 0, 1);

int main(void)
{
	struct gamepad_state state;
	int ret;

	LOG_INF("Comet Gamepad firmware %s", APP_VERSION_STRING);

	ret = status_led_init();
	if (ret < 0) {
		LOG_WRN("Running without the status LED (%d)", ret);
	}

	/* Loads the stored settings, such as the left stick calibration, before input starts. */
	ret = storage_init();
	if (ret < 0) {
		LOG_WRN("Running with the default settings (%d)", ret);
	}

	ret = gamepad_input_init(&report_sem);
	if (ret < 0) {
		return ret;
	}

	ret = gamepad_combos_init();
	if (ret < 0) {
		LOG_WRN("Running without button combinations (%d)", ret);
	}

	ret = gamepad_hid_init(&report_sem);
	if (ret < 0) {
		return ret;
	}

	ret = gamepad_usb_init();
	if (ret < 0) {
		return ret;
	}

	while (true) {
		uint32_t idle_ms = gamepad_hid_idle_ms();

		/*
		 * Wait for a change. With an idle rate set by the host, the report is also sent
		 * again when nothing changed for that long, as the HID specification asks.
		 */
		(void)k_sem_take(&report_sem, (idle_ms == 0U) ? K_FOREVER : K_MSEC(idle_ms));

		gamepad_input_get_state(&state);

		/*
		 * This waits until the host has read the report, so the USB polling interval
		 * already limits the report rate. Changes that happen while it waits are merged
		 * into the next report.
		 */
		ret = gamepad_hid_submit(&state);
		if (ret < 0 && ret != -EAGAIN) {
			LOG_WRN("Failed to send the report (%d)", ret);

			/* Do not retry in a tight loop. */
			k_msleep(ERROR_RETRY_DELAY_MS);
		}
	}

	return 0;
}
```

## src/gamepad_combos.c
```c
/*
 * Copyright (c) 2026 Mecha Systems
 *
 * SPDX-License-Identifier: BSD-3-Clause
 */

/*
 * All the button combinations of the gamepad are here, so that the buttons of every combination can
 * be compared in one place. No combination may be part of another one that can be active at the
 * same time. They only start after a long hold, and the host still sees the buttons.
 *
 * Select + Start is for the system:
 *   + LB + RB      restarts into the boot ROM to write new firmware.
 *   + Home         (held at power-up) erases the stored settings.
 * L3, the stick button, is for the sticks:
 *   + Home         measures the rest position of the right stick again.
 *   + Select       (held at power-up) calibrates the left stick.
 *
 * Home + LB and Home + RB are kept free for a possible trigger and bumper swap.
 */

#include <zephyr/dt-bindings/input/input-event-codes.h>
#include <zephyr/sys/util.h>

#include "bootloader/bootloader.h"
#include "combo/combo.h"
#include "factory_reset/factory_reset.h"
#include "gamepad_combos.h"
#include "left_stick/left_stick.h"
#include "right_stick/right_stick.h"

static const struct combo_def gamepad_combos[] = {
	COMBO_DEF("bootloader", COMBO_PHASE_ANY, 3000, bootloader_enter, INPUT_BTN_SELECT,
		  INPUT_BTN_START, INPUT_BTN_TL, INPUT_BTN_TR),
	COMBO_DEF("factory-reset", COMBO_PHASE_POWER_UP, 5000, factory_reset_perform,
		  INPUT_BTN_SELECT, INPUT_BTN_START, INPUT_BTN_MODE),
	COMBO_DEF("recalibrate-right-stick", COMBO_PHASE_ANY, 1500, right_stick_recalibrate,
		  INPUT_BTN_THUMBL, INPUT_BTN_MODE),
	COMBO_DEF("calibrate-left-stick", COMBO_PHASE_POWER_UP, 1000, left_stick_calibration_start,
		  INPUT_BTN_THUMBL, INPUT_BTN_SELECT),
};

int gamepad_combos_init(void)
{
	int ret;

	ret = combo_init(gamepad_combos, ARRAY_SIZE(gamepad_combos));
	if (ret < 0) {
		return ret;
	}

	/* Buttons that are held now were held at power-up, as no event tells about them. */
	combo_seed_from_gpio_keys();

	return 0;
}
```
